## Kconfig.board
```kconfig
# Kconfig - NUCLEO-64 F411RE board configuration
#
# Copyright (c) 2016 Matthias Boesl
#
# SPDX-License-Identifier: Apache-2.0
#

config BOARD_NUCLEO_F207ZG
	bool "NUCLEO-144 F207ZG Development Board"
	depends on SOC_STM32F207ZG
```
